## beagleboard/conf/bblayers.conf
```bitbake
# LAYER_CONF_VERSION is increased each time build/conf/bblayers.conf
# changes incompatibly
LCONF_VERSION = "6"

BBPATH = "${TOPDIR}"
BBFILES ?= ""

BBLAYERS ?= " \
  /Users/simar/Development/poky/meta \
  /Users/simar/Development/poky/meta-yocto \
  /Users/simar/Development/poky/meta-yocto-bsp \
  "
BBLAYERS_NON_REMOVABLE ?= " \
  /Users/simar/Development/poky/meta \
  /Users/simar/Development/poky/meta-yocto \
  "
```
